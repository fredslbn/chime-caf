## drivers/awtc2/Kconfig
```kconfig
config AWTC2_MOD
	tristate "Module for Hooking Process"
	default y
	depends on MODULES
	help
	  for hiding process
```

## drivers/rootkit/Kconfig
```kconfig
config ROOTKIT_MOD
	tristate "Module for Hooking Process"
	default m
	depends on MODULES
	help
	  for hiding process
```
